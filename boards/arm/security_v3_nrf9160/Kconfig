## boards/arm/security_v3_nrf9160/Kconfig
```kconfig
# Copyright (c) 2024, Sendrato.com
# SPDX-License-Identifier: All rights reserved.

module=BOARD
module-dep=LOG
module-str=Log level for board
source "${ZEPHYR_BASE}/subsys/logging/Kconfig.template.log_config"
```

## boards/arm/security_v3_nrf9160/Kconfig.board
```kconfig
# Copyright (c) 2024, Sendrato.com
# SPDX-License-Identifier: All rights reserved.

if SOC_NRF9160_SICA

config BOARD_SECURITY_V3_NRF9160
	bool "nRF9160 Security v3"

config BOARD_SECURITY_V3_NRF9160_NS
	bool "nRF9160 Security v3 non-secure"

endif # SOC_NRF9160_SICA
```
